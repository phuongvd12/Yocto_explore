## poky/build/conf/bblayers.conf
```bitbake
# POKY_BBLAYERS_CONF_VERSION is increased each time build/conf/bblayers.conf
# changes incompatibly
POKY_BBLAYERS_CONF_VERSION = "2"

BBPATH = "${TOPDIR}"
BBFILES ?= ""

BBLAYERS ?= " \
  /home/f4/Documents/Linux/udemy/Yocto/youtobe/Yocto_explore/poky/meta \
  /home/f4/Documents/Linux/udemy/Yocto/youtobe/Yocto_explore/poky/meta-poky \
  /home/f4/Documents/Linux/udemy/Yocto/youtobe/Yocto_explore/poky/meta-yocto-bsp \
  "
```
